## components/ble_stack/Kconfig
```kconfig
#
# Copyright (c) 2018 Nordic Semiconductor
#
# SPDX-License-Identifier: LicenseRef-Nordic-5-Clause
#

source "Kconfig.zephyr"

menu "BLE Wrapper Configuration"

config BT_DEVICE_TO_CONNECT
	string "Bluetooth device name"
	default "BAT_ESU"
	help
	  Bluetooth device name to connect. Name can be up to 248 bytes long (excluding
	  NULL termination). Can be empty string.

config BT_NUS_THREAD_STACK_SIZE
	int "Thread stack size"
	default 1024
	help
	  Stack size used of the ble_write_thread thread

config BT_NUS_UART_BUFFER_SIZE
	int "UART payload buffer element size"
	default 40
	help
	  Size of the payload buffer in each RX and TX FIFO element

config BT_NUS_SECURITY_ENABLED
	bool "Enable security"
	default y
	select BT_SMP
	help
	  "Enable BLE security for the UART service"

config BT_NUS_UART_RX_WAIT_TIME
	int "Timeout for UART RX complete event"
	default 50
	help
	  Wait for RX complete event time in milliseconds

config BT_NUS_UART_ASYNC_ADAPTER
	bool "Enable UART async adapter"
	select SERIAL_SUPPORT_ASYNC
	help
	  Enables asynchronous adapter for UART drives that supports only
	  IRQ interface.

config BT_DEV_DIS_STR_MAX
	int "Maximum size in bytes for DIS strings"
	default 31
	range 2 248
	help
	  Bluetooth DIS string storage size. Storage can be up to 248 bytes
	  long (excluding NULL termination).

config BT_DEV_DIS_MODEL
	string "Model name"
	default SOC
	help
	  The device model inside Device Information Service.

config BT_DEV_DIS_SERIAL_NUMBER_STR
	string "Serial Number"
	help
	  Enable Serial Number characteristic in Device Information Service.

config BT_DEV_DIS_MANUF
	string "Manufacturer name"
	default "Manufacturer"
	help
	  The device manufacturer inside Device Information Service.

config BT_DEV_DIS_FW_REV_STR
	string "Firmware revision"
	default "0.0.0+0"
	help
	  Enable firmware revision characteristic in Device Information Service for the device.

config BT_DEV_DIS_SW_REV_STR
	string "Software revision"
	default "0.0.0+0"
	help
	  Enable software revision characteristic in Device Information Service for the device.

config BT_DEV_DIS_SYSTEM_ID
	bool "DIS System ID characteristic [experimental]"
	help
	  Enable System ID characteristic in Device Information Service.
	  The System ID characteristic is used to represent an extended unique identifier (EUI) of the system
	  implementing the service that contains this characteristic. This 64-bit structure is an EUI-64 which consists
	  of an Organizationally Unique Identifier (OUI) concatenated with a manufacturer-defined identifier.

	  This will be transmitted as the 40 bit identifier followed by the 24-bit OUI.
	  Both in little-endian format.

if BT_DEV_DIS_SYSTEM_ID
config BT_DEV_DIS_SYSTEM_ID_OUI
	hex "Organizationally Unique Identifier (OUI) of the manufacturer."
	range 0 0xFFFFFF
	default 0
	help
	  The OUI is a 24-bit number issued by the IEEE Registration Authority.
	  System ID characteristic in Device Information Service.
	  Shall contain an Organisationally Unique Identifier (OUI) followed by a manufacturer-defined indentifier unique for the device.

config BT_DEV_DIS_SYSTEM_ID_IDENTIFIER
	hex "Manufacturer-defined unique identifier."
	range 0 0xFFFFFFFFFF
	default 0
	help
	  The manufacturer-defined unique identifier is 40 bits long.
endif # BT_DIS_SYSTEM_ID

config  BT_GATT_DB_AUTH_AND_ENCRYPTION
	bool "GATT: require encryption/auth for R/W + bonding preset"
	default n
	depends on BT
	help
	  When enabled, build the app with encryption/authentication-oriented defaults for GATT read and write permissions.
	select BT_SETTINGS
	select BT_FILTER_ACCEPT_LIST
	select BT_PRIVACY
	select BT_BONDABLE
	select BT_FIXED_PASSKEY
	select BT_SECURITY_ERR_TO_STR

endmenu
```
